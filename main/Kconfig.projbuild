## main/Kconfig.projbuild
```kconfig
menu "REMOTE UART BRIDGE"

    choice REMOTE_UART_ROLE
        prompt "Device role"
        default REMOTE_UART_ROLE_SERVER if !IDF_TARGET_ESP32C3
        default REMOTE_UART_ROLE_CLIENT if IDF_TARGET_ESP32C3

    config REMOTE_UART_ROLE_SERVER
        bool "Server (listen for connections)"

    config REMOTE_UART_ROLE_CLIENT
        bool "Client (connect to remote)"

    endchoice

endmenu
```

## sdkconfig.defaults.esp32c3
```kconfig
CONFIG_IDF_TARGET="esp32c3"

CONFIG_ESPTOOLPY_FLASHSIZE_4MB=y
CONFIG_PARTITION_TABLE_CUSTOM=y
CONFIG_PARTITION_TABLE_CUSTOM_FILENAME="esp32c3_partition_table.csv"

CONFIG_REMOTE_UART_ROLE_CLIENT=y
```

## sdkconfig.defaults.esp32s3
```kconfig
CONFIG_IDF_TARGET="esp32s3"

CONFIG_ESPTOOLPY_FLASHSIZE_8MB=y
CONFIG_PARTITION_TABLE_CUSTOM=y
CONFIG_PARTITION_TABLE_CUSTOM_FILENAME="esp32s3_partition_table.csv"

CONFIG_REMOTE_UART_ROLE_SERVER_CHOICE=y

CONFIG_TINYUSB_CDC_ENABLED=y
CONFIG_TINYUSB_CDC_RX_BUFSIZE=1024
CONFIG_TINYUSB_CDC_TX_BUFSIZE=1024
CONFIG_TINYUSB_CDC_EP_BUFSIZE=1024
```
